## tags/0.32/src/buildroot/package/customize/Config.in
```kconfig
menu "FOG Custom Components"
source "package/customize/clamav/Config.in"
source "package/customize/parted/Config.in"
source "package/customize/partimage/Config.in"
source "package/customize/dmidecode/Config.in"
source "package/customize/chntpw/Config.in"
source "package/customize/selectcore/Config.in"
source "package/customize/testdisk/Config.in"
source "package/customize/fog/Config.in"
source "package/customize/pigz/Config.in"
source "package/customize/gdisk/Config.in"
source "package/customize/ntfsprogsfog/Config.in"
endmenu
```

## tags/0.32/src/buildroot/package/customize/parted/Config.in
```kconfig
config BR2_PACKAGE_PARTED
	bool "GNU Parted"
	select BR2_PACKAGE_E2FSPROGS_LIBUUID
	help
	  GNU Parted is an industrial-strength package for manipulating partition tables. 
	  This is useful for creating space for new operating systems, reorganising disk usage, 
	  copying data on hard disks and disk imaging.
```

## tags/0.32/src/buildroot/package/customize/partimage/Config.in
```kconfig
config BR2_PACKAGE_PARTIMAGE
	bool "Partimage"
	select BR2_PACKAGE_ZLIB
	select BR2_PACKAGE_BZIP2
	select BR2_PACKAGE_NEWT
	select BR2_PACKAGE_OPENSSL
	help
	  Partimage is opensource disk backup software. It saves partitions having a supported 
	  filesystem on a sector basis to an image file. Although it runs under Linux, Windows 
	  and most Linux filesystems are supported. The image file can be compressed to save 
	  disk space and transfer time and can be split into multiple files to be copied to 
	  CDs or DVDs. 
```

## tags/0.32/src/buildroot/package/customize/selectcore/Config.in
```kconfig
config BR2_PACKAGE_SELECTCORE
	bool "Select Core Utilites"
	depends on BR2_USE_WCHAR 
	help
	  base64 and shred binaries
```

## trunk/src/buildroot/package/customize/dmidecode/Config.in
```kconfig
config BR2_PACKAGE_DMIDECODE
	bool "DMI Decode"
	select BR2_PACKAGE_E2FSPROGS_LIBUUID
	help
	  Dmidecode reports information about your system's hardware as described 
	  in your system BIOS according to the SMBIOS/DMI standard. This information 
	  typically includes system manufacturer, model name, serial number, BIOS 
	  version, asset tag as well as a lot of other details of varying level of 
	  interest and reliability depending on the manufacturer. 
```

## trunk/src/buildroot/package/customize/gdisk/Config.in
```kconfig
config BR2_PACKAGE_GDISK
	bool "GPT fdisk"
	select BR2_PACKAGE_POPT
	help
           GPT fdisk (consisting of the gdisk and sgdisk programs) is 
           a text-mode partitioning tool for Linux, FreeBSD, Mac OS X, 
           and Windows that works on Globally Unique Identifier (GUID) 
           Partition Table (GPT) disks, rather than on the more common 
           (through 2009) Master Boot Record (MBR) partition tables.
```
